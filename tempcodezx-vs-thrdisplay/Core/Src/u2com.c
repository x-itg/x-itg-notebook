#include "u2com.h"

RUDATA sRundata;

unsigned char RxBufU2[MAXRXU2];
unsigned char TxBufU2[200];
unsigned short RxLenU2 = 0;
unsigned short rsRxIndex = 0;
unsigned char rsPackFlag = 0;
unsigned short rsRxTime = 0;
unsigned short rsRxLen = 0;
unsigned char rsRxBuf[200];
static const unsigned char aucCRCHi[] = {
    0x00, 0xC1, 0x81, 0x40, 0x01, 0xC0, 0x80, 0x41, 0x01, 0xC0, 0x80, 0x41,
    0x00, 0xC1, 0x81, 0x40, 0x01, 0xC0, 0x80, 0x41, 0x00, 0xC1, 0x81, 0x40,
    0x00, 0xC1, 0x81, 0x40, 0x01, 0xC0, 0x80, 0x41, 0x01, 0xC0, 0x80, 0x41,
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    0x00, 0xC1, 0x81, 0x40};

static const unsigned char aucCRCLo[] = {
    0x00, 0xC0, 0xC1, 0x01, 0xC3, 0x03, 0x02, 0xC2, 0xC6, 0x06, 0x07, 0xC7,
    0x05, 0xC5, 0xC4, 0x04, 0xCC, 0x0C, 0x0D, 0xCD, 0x0F, 0xCF, 0xCE, 0x0E,
    0x0A, 0xCA, 0xCB, 0x0B, 0xC9, 0x09, 0x08, 0xC8, 0xD8, 0x18, 0x19, 0xD9,
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    0x41, 0x81, 0x80, 0x40};

unsigned short CRC16x(unsigned char *pucFrame, unsigned short usLen)
{
    unsigned char ucCRCHi = 0xFF;
    unsigned char ucCRCLo = 0xFF;
    int iIndex;

    while (usLen--)
    {
        iIndex = ucCRCLo ^ *(pucFrame++);
        ucCRCLo = (unsigned char)(ucCRCHi ^ aucCRCHi[iIndex]);
        ucCRCHi = aucCRCLo[iIndex];
    }
    return (unsigned short)(ucCRCHi << 8 | ucCRCLo);
}
void LoadReadData(void)
{
    sRundata.Ta = Ta;
    sRundata.Tb = Tb;
    sRundata.Tc = Tc;
    sRundata.pTa = pTa;
    sRundata.pTb = pTb;
    sRundata.pTc = pTc;

    sRundata.FenH = FenH;
    sRundata.FenM = FenM;
    sRundata.Tcala1 = Tcala1;
    sRundata.Tcala2 = Tcala2;
    sRundata.Tcala3 = Tcala3;
    sRundata.Tset1 = Tset1;
    sRundata.Tset2 = Tset2;
    sRundata.Tset3 = Tset3;
    sRundata.Tset4 = Tset4;
    sRundata.cshuiCha = cshuiCha;
    sRundata.cwhuiCha = cwhuiCha;
    sRundata.tzhuiCha = tzhuiCha;
    sRundata.MnTest = MnTest;

    sRundata.addr = addr;
    sRundata.jojy = jojy;
    sRundata.btlv = btlv;

    sRundata.k1 = (signed int)k1 * 10;
    sRundata.k2 = (signed int)k2 * 10;
    sRundata.k3 = (signed int)k3 * 10;
    sRundata.b1 = (signed int)b1 * 10;
    sRundata.b2 = (signed int)b2 * 10;
    sRundata.b3 = (signed int)b3 * 10;

    sRundata.macFlag[0] = FengJiSW;          // 0     风机
    sRundata.macFlag[1] = MacFailed;         // 1     故障
    sRundata.macFlag[2] = OverTemp;          // 2     超温报警
    sRundata.macFlag[3] = JumpZha;           // 3     跳闸
    sRundata.macFlag[4] = DoorJin;           // 4     门禁
    sRundata.macFlag[5] = TempASta;          // 5     a温度故障0 1过低 2过高
    sRundata.macFlag[6] = TempBSta;          // 6     b温度故障0 1过低 2过高
    sRundata.macFlag[7] = TempCSta;          // 7     c温度故障0 1过低 2过高
    sRundata.macFlag[8] = PowrASta;          // 8     a没电故障0 1没电
    sRundata.macFlag[9] = PowrBSta;          // 9     b没电故障0 1没电
    sRundata.macFlag[10] = 0x00;             // 10
    sRundata.macFlag[11] = 0x00;             // 11
    sRundata.macFlag[12] = MODAutoManuONOFF; // 12    0自动     1手动开 2手动关
    sRundata.macFlag[13] = 0x00;             // 13
    sRundata.macFlag[14] = disBeep;          // 14    0不叫     1叫  beep
    sRundata.macFlag[15] = goBeep;           // 15    0不消音   1消音
    sRundata.macFlag[16] = MODLoopShow;      // 16    0巡回     1最大温度显示
}
void u2RxIt(UART_HandleTypeDef *huart)
{

    __HAL_UART_CLEAR_IDLEFLAG(huart);

    HAL_UART_DMAStop(huart);

    __HAL_UART_CLEAR_FLAG(huart, UART_CLEAR_OREF | UART_CLEAR_NEF | UART_CLEAR_PEF | UART_CLEAR_FEF);

    RxLenU2 = MAXRXU2 - huart->hdmarx->Instance->CNDTR; // NDTR;
    unsigned short i = 0;

    extern unsigned int addr;
    if (RxBufU2[0] == addr &&
        RxBufU2[1] == 0x03 &&
        RxBufU2[2] == 0x00 &&
        RxBufU2[3] == 0x00 &&
        RxBufU2[4] == 0x00 &&
        RxBufU2[5] == 0x05 && RxLenU2 == 8)
    {
        i = 0;
        TxBufU2[0] = addr;
        TxBufU2[1] = 0x03;
        TxBufU2[2] = 0x0A;
        unsigned short Tmp = 0;
        if (Ta > Tset3)
            Tmp = Tmp | 0x0001;
        else
            Tmp = Tmp & (~0x0001);
        if (Tb > Tset3)
            Tmp = Tmp | 0x0002;
        else
            Tmp = Tmp & (~0x0002);
        if (Tc > Tset3)
            Tmp = Tmp | 0x0004;
        else
            Tmp = Tmp & (~0x0004);
        if (FengJiSW != 0)
            Tmp = Tmp | 0x0008;
        else
            Tmp = Tmp & (~0x0008);
        if (MacFailed != 0)
            Tmp = Tmp | 0x0010;
        else
            Tmp = Tmp & (~0x0010);
        if (OverTemp != 0)
            Tmp = Tmp | 0x0020;
        else
            Tmp = Tmp & (~0x0020);
        TxBufU2[3] = Tmp >> 8;
        TxBufU2[4] = Tmp >> 0;
        signed short Txxx = 0;
        Txxx = Ta * 10 + 0x23;
        TxBufU2[5] = Txxx >> 8;
        TxBufU2[6] = Txxx >> 0;
        Txxx = Tb * 10 + 0x23;
        TxBufU2[7] = Txxx >> 8;
        TxBufU2[8] = Txxx >> 0;
        Txxx = Tc * 10 + 0x23;
        TxBufU2[9] = Txxx >> 8;
        TxBufU2[10] = Txxx >> 0;
        TxBufU2[11] = FenH >> 8;
        TxBufU2[12] = FenH >> 0;
        unsigned short crc1, crc2;
        crc1 = crc2 = CRC16x(TxBufU2, 13);
        TxBufU2[13] = ((crc1)&0xff);
        TxBufU2[14] = ((crc2 >> 8) & 0xff);

        TxEn;
        ADCPause;
        HAL_UART_Transmit(huart, TxBufU2, 15, 100);
        ADCContinue;
    }
    if (
        RxBufU2[0] == 0xFA &&
        RxBufU2[1] == 0x04 &&
        RxBufU2[2] == 0xD1 &&
        RxBufU2[5] == 0xFB && RxLenU2 == 6)
    {
        MODAutoManuONOFF = RxBufU2[3];
        ADCPause;
        TxEn;
        HAL_UART_Transmit(huart, RxBufU2, rsRxIndex, 100);
        ADCContinue;
    }

    if (
        RxBufU2[0] == 0xFA &&
        RxBufU2[1] == 0x04 &&
        RxBufU2[2] == 0xD2 &&
        RxBufU2[5] == 0xFB && RxLenU2 == 6)
    {
        goBeep = RxBufU2[3];
        ADCPause;
        TxEn;
        HAL_UART_Transmit(huart, RxBufU2, rsRxIndex, 100);
        ADCContinue;
    }

    if (
        RxBufU2[0] == 0xFA &&
        RxBufU2[1] == 0x04 &&
        RxBufU2[2] == 0xF1 &&
        RxBufU2[5] == 0xFB && RxLenU2 == 6)
    {
        i = 0;
        TxBufU2[i++] = 0xFA;
        TxBufU2[i++] = 0x04;
        TxBufU2[i++] = 0xF1;
        unsigned int sDataLen = sizeof(sRundata);
        LoadReadData();
        memcpy(&TxBufU2[i], (unsigned char *)&sRundata, sDataLen);
        i = i + sDataLen;
        TxBufU2[i++] = 0xFB;
        ADCPause;
        TxEn;
        HAL_UART_Transmit(huart, TxBufU2, i, 100);
        ADCContinue;
    }
    HAL_UART_Receive_DMA(huart, RxBufU2, MAXRXU2);
    RxEn;
}