//////////////////////////////////////////////////////////////////////////////////	 
//本程序只供学习使用，未经作者许可，不得用于其它任何用途
//中景园电子
//店铺地址：http://shop73023976.taobao.com/?spm=2013.1.0.0.M4PqC2
//
//  文 件 名   : LCD_ZK.c
//  版 本 号   : v2.0
//  作    者   : HuangKai
//  生成日期   : 2014-0101
//  最近修改   : 
//  功能描述   : 字库版 OLED SPI接口演示例程(STM32系列)
//              说明: 
//              ------------------------以下为OLED显示所用到的接�----------------------------------------
//              GND    电源地
//              VCC  接5V或3.3v电源
//              D0   PA2（CLK）
//              D1   PA3（DIN）
//              RES  PA4
//              DC   PA5
//              CS   PA1                
//              --------------------------以上为OLED显示所用到的接口--------------------------------------
//              ------------------------以下为OLED字库部分所用到的接�----------------------------------------
//              OUT   PB10	SPI	
//              IN  	PB11
//              SCK   PB9
//              CS2   PB7                
//              --------------------------以上为OLED字库部分所用到的接口--------------------------------------
// 修改历史   :
// 日    期   : 
// 作    者   : HuangKai
// 修改内容   : 创建文件
//版权所有，盗版必究。
//Copyright(C) 中景园电子2014/3/16
//All rights reserved
//******************************************************************************/
#include "LCD_ZK.h"
#include "oled.h"

#define uchar unsigned char 
#define uint unsigned int
#define ulong unsigned long



unsigned char const bmp1[]={
  /*--  调入了一幅图像：D:\我的文档\My Pictures\12864-555.bmp  --*/
  /*--  宽度x高度=128x64  --*/
  0x00,0x00,0x00,0x00,0x00,0x00,0x00,0x00,0x00,0x00,0x00,0x00,0x00,0x00,0x00,0x00,
  0x00,0x00,0x00,0x80,0x80,0xC0,0xC0,0xC0,0xC0,0xE0,0x60,0xE0,0xE0,0xE0,0xE0,0x60,
  0x60,0x60,0x60,0x60,0x60,0x60,0xE0,0xE0,0xE0,0xE0,0xC0,0xC0,0xC0,0xC0,0x80,0x80,
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  0x00,0x00,0x00,0x00,0x00,0x00,0x00,0x00,0x00,0x00,0x00,0x00,0x00,0x00,0x00,0x00,
  
};


unsigned char const jiong1[]={/*--  文字:  囧  --*/
  /*--  宋体12;  此字体下对应的点阵为：宽x高=16x16   --*/
  0x00,0xFE,0x82,0x42,0xA2,0x9E,0x8A,0x82,0x86,0x8A,0xB2,0x62,0x02,0xFE,0x00,0x00,
  0x00,0x7F,0x40,0x40,0x7F,0x40,0x40,0x40,0x40,0x40,0x7F,0x40,0x40,0x7F,0x00,0x00};

unsigned char const lei1[]={/*--  文字:  畾  --*/
  /*--  宋体12;  此字体下对应的点阵为：宽x高=16x16   --*/
  0x80,0x80,0x80,0xBF,0xA5,0xA5,0xA5,0x3F,0xA5,0xA5,0xA5,0xBF,0x80,0x80,0x80,0x00,
  0x7F,0x24,0x24,0x3F,0x24,0x24,0x7F,0x00,0x7F,0x24,0x24,0x3F,0x24,0x24,0x7F,0x00};

void OLED_GPIO_Config(void);
void GBZK_GPIO_Config(void);
#define nnus 20
extern void delay_us(volatile uint16_t us);
#define ROM_OUT    (GPIOB->IDR&(1<<3))//GPIO_ReadInputDataBit(GPIOB,GPIO_Pin_10)

void GBZK_ROMOUT_IN(void)
{		
  
  GPIO_InitTypeDef GPIO_InitStruct;
  GPIO_InitStruct.Pin = GPIO_PIN_3;//SPISO_Pin;
  GPIO_InitStruct.Mode = GPIO_MODE_INPUT;//GPIO_Mode_IPD
  GPIO_InitStruct.Pull = GPIO_PULLDOWN;
  HAL_GPIO_Init(GPIOB, &GPIO_InitStruct);	  	 
  
}

void GBZK_ROMOUT_OUT(void)
{		
  GPIO_InitTypeDef GPIO_InitStruct;
  GPIO_InitStruct.Pin = GPIO_PIN_3;//SPISO_Pin;
  GPIO_InitStruct.Mode = GPIO_MODE_OUTPUT_OD;//GPIO_Mode_Out_OD
  GPIO_InitStruct.Pull = GPIO_NOPULL;
  HAL_GPIO_Init(GPIOB, &GPIO_InitStruct);		  	 
}


 

 

/*延时*/
void delay(int n_ms)               
{
  int j,k;
  for(j=0;j<n_ms;j++)
    for(k=0;k<5500;k++);
}


/*等待一个按键，我的主板是用P2.0与GND之间接一个按键*/
#if 0
void waitkey()
{
repeat:
  if (P2&0x01) goto repeat;
  else delay(6);
  if (P2&0x01) goto repeat;
  else
    delay(40);;
}
#endif


void Rom_CS(unsigned char a)
{
  if (a){
    GPIOB->BSRR=(1<<5);
  }else	{
    GPIOB->BRR=(1<<5);
  }
}
void Rom_IN(unsigned char a)
{
  if (a)
    GPIOA->BSRR=(1<<15);
  else		
    GPIOA->BRR=(1<<15);
}

void Rom_SCK(unsigned char a)
{
  if (a)	
    GPIOB->BSRR=(1<<4);
  else		
    GPIOB->BRR=(1<<4);
}

void Rom_OUT(unsigned char a)
{
  if (a)	
    GPIOB->BSRR=(1<<3);
  else		
    GPIOB->BRR=(1<<3);
}

/*LCD模块初始化*/
void initial_rom(void)
{
  Rom_CS(1);
}

void lcd_address(uchar page,uchar column)
{

}



/****送指令到晶联讯字库IC***/
void send_command_to_ROM( uchar datu )
{
  uchar i;
  for(i=0;i<8;i++ )
  {
    if(datu&0x80)
    {
      Rom_IN(1);;;
      delay_us(nnus);
    }
    else
    {
      Rom_IN(0);;; 
      delay_us(nnus); 
    }
    datu = datu<<1;
    Rom_SCK(0);;;
    delay_us(nnus);
    Rom_SCK(1);;;
    delay_us(nnus);
  }
}

/****从晶联讯字库IC中取汉字或字符数据（1个字节）***/
static uchar get_data_from_ROM( )
{
  
  uchar i;
  uchar ret_data=0;
  Rom_SCK(1);;; 
  
  delay_us(nnus);

  for(i=0;i<8;i++)
  {
    //GBZK_ROMOUT_OUT();//输出
    //delay_us(nnus);
    //Rom_OUT(1);;; 
    
    delay_us(nnus);
    Rom_SCK(0);;;
    
    delay_us(nnus);
    //GBZK_ROMOUT_IN();//输入
    //delay_us(nnus);
    
    ret_data=ret_data<<1;
    
    if( ROM_OUT!=0 )
    {
      ret_data=ret_data+1;;;
      delay_us(nnus);
    }
    else
    {
      ret_data=ret_data+0;;;
      delay_us(nnus);	
    }
    Rom_SCK(1);
  }

  return(ret_data);
}



/*从相关地址（addrHigh：地址高字节,addrMid：地址中字节,addrLow：地址低字节）中连续读出DataLen个字节的数据到 pBuff的地址*/
/*连续读取*/
void get_n_bytes_data_from_ROM(uchar addrHigh,uchar addrMid,uchar addrLow,uchar *pBuff,uchar DataLen )
{
  uchar i;
  Rom_CS(0);
  Rom_SCK(0);
  send_command_to_ROM(0x03);
  send_command_to_ROM(addrHigh);
  send_command_to_ROM(addrMid);
  send_command_to_ROM(addrLow);
  for(i = 0; i < DataLen; i++ )
  {
    *(pBuff+i) =get_data_from_ROM();
  }
  Rom_CS(1);
}


/******************************************************************/

ulong  fontaddr=0;

void display_GB2312_string(uchar y,uchar x,uchar *text)
{
  unsigned char posx=0,posy=0,xsnum=0;
  unsigned char nullshow[16]={0};
  uchar i= 0;
  uchar addrHigh,addrMid,addrLow ;
  uchar fontbuf[32];			
  while((text[i]>0x00))
  {
    if((((text[i]>=0xb0) &&(text[i]<=0xf7))&&(text[i+1]>=0xa1)))
    {						
      
      fontaddr = (text[i]- 0xb0)*94; 
      fontaddr += (text[i+1]-0xa1)+846;
      fontaddr = (ulong)(fontaddr*32);
      
      addrHigh = (fontaddr&0xff0000)>>16;  
      addrMid = (fontaddr&0xff00)>>8;      
      addrLow = fontaddr&0xff;	    
      get_n_bytes_data_from_ROM(addrHigh,addrMid,addrLow,fontbuf,32 );
      OLED_16X16(x,y,fontbuf);//
       xsnum=xsnum+2;
       posx=posx+16;
       if(posx>127)
       {
         posx=0;
         posy=2;
       }
      //display_graphic_16x16(y,x,fontbuf);
      i+=2;
      x+=16;
    }
    else if(((text[i]>=0xa1) &&(text[i]<=0xa3))&&(text[i+1]>=0xa1))
    {						
     
      fontaddr = (text[i]- 0xa1)*94; 
      fontaddr += (text[i+1]-0xa1);
      fontaddr = (ulong)(fontaddr*32);
      
      addrHigh = (fontaddr&0xff0000)>>16;  
      addrMid = (fontaddr&0xff00)>>8;      
      addrLow = fontaddr&0xff;	     
      get_n_bytes_data_from_ROM(addrHigh,addrMid,addrLow,fontbuf,32 );

      OLED_16X16(x,y,fontbuf);//
      xsnum=xsnum+2;
       posx=posx+16;
       if(posx>127)
       {
         posx=0;
         posy=2;
       }
      //display_graphic_16x16(y,x,fontbuf);
      i+=2;
      x+=16;
    }
    else if((text[i]>=0x20) &&(text[i]<=0x7e))	
    {
      unsigned char see=text[i];
      unsigned char fontbuf[16];			
      fontaddr = (text[i]- 0x20);
      fontaddr = (unsigned long)(fontaddr*16);
      fontaddr = (unsigned long)(fontaddr+0x3cf80);			
      addrHigh = (fontaddr&0xff0000)>>16;
      addrMid = (fontaddr&0xff00)>>8;
      addrLow = fontaddr&0xff;
      
      get_n_bytes_data_from_ROM(addrHigh,addrMid,addrLow,fontbuf,16 );
      
      OLED_8X16(x,y,fontbuf);
     
      xsnum=xsnum+1;
      posx=posx+8;
      if(posx>127)
       {
         posx=0;
         posy=2;
       }
       
      //display_graphic_8x16(y,x,fontbuf);
      i+=1;
      x+=8;
    }
    else
      i++;
  }
  
 
}

void display_string_5x7(uchar y,uchar x,uchar *text)
{
  unsigned char i= 0;
  unsigned char addrHigh,addrMid,addrLow ;
  while((text[i]>0x00))
  {
    if((text[i]>=0x20) &&(text[i]<=0x7e))	
    {						
      unsigned char fontbuf[8];			
      fontaddr = (text[i]- 0x20);
      fontaddr = (unsigned long)(fontaddr*8);
      fontaddr = (unsigned long)(fontaddr+0x3bfc0);			
      addrHigh = (fontaddr&0xff0000)>>16;
      addrMid = (fontaddr&0xff00)>>8;
      addrLow = fontaddr&0xff;
      
      get_n_bytes_data_from_ROM(addrHigh,addrMid,addrLow,fontbuf,8);/*取8个字节的数据，存到"fontbuf[32]"*/
      
      display_graphic_5x7(y,x,fontbuf);/*显示5x7的ASCII字到LCD上，y为页地址，x为列地址，fontbuf[]为数据*/
      i+=1;
      x+=6;
    }
    else
      i++;	
  }
  
}


